## buildroot-v86/Config.in
```kconfig
source "$BR2_EXTERNAL_v86_PATH/package/nled/Config.in"
source "$BR2_EXTERNAL_v86_PATH/package/tcc/Config.in"
source "$BR2_EXTERNAL_v86_PATH/package/gcc-target/Config.in"
```

## buildroot-v86/package/tcc/Config.in
```kconfig
config BR2_PACKAGE_TCC
	bool "tcc"
	help
	  tinycc is a small C compiler for small systems.
```
